## main/Kconfig.projbuild
```kconfig
menu "Aplicação"

    choice APP_MODE
        bool "Selecione o modo da aplicação"
        default JOYSTICK
        
        config CAR
            bool "Modo de controle do carrinho"
        config JOYSTICK
            bool "Modo de controle do carrinho por joystick"
    endchoice

    config WIFI_SSID
        string "SSID do Wifi"
        default "myssid"

    config WIFI_PASSWORD
        string "Senha do Wifi"
        default "mypassword"
    
    config WIFI_MAXIMUM_RETRY
        int "Número máximo de tentativas de conexão"
        default 5
        help
            Configure o valor máximo de tentativas de conexão.
    
    config MQTT_HOST
        string "Endereço do servidor MQTT"
        default "mqt://host"
    config MQTT_TOKEN
        string "Endereço do servidor MQTT"
        default "token_de_acesso"
endmenu
```
